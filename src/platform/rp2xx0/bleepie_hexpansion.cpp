// BleepieMeshtastic — Tildagon hexpansion EEPROM emulation + badge UART bridge,
// running entirely on core1 so Meshtastic's core0 main loop is untouched.
//
// Compiled only for the bleepie board (BLEEPIE_MESHTASTIC). The board's SX1262
// build defines MESHTASTIC_EXCLUDE_I2C, so Meshtastic never drives i2c0 — this
// module owns i2c0 (GPIO12/13) as a slave and emulates a 64 KB EEPROM carrying a
// LittleFS image with the badge app. It also serves a terse UART bridge on
// Serial1 (GPIO28/29) backed by the shared BleepieBridge snapshot.
//
// core1 is entered via the arduino-pico weak setup1()/loop1() hooks, which the
// FreeRTOS glue runs on a task pinned to core1 (vTaskCoreAffinitySet(_, 1<<1)).
// The EEPROM is RAM-only (no LittleFS writes from core1) to avoid cross-core
// flash-XIP contention with Meshtastic's config saves.

// BLEEPIE_CORE1_DISABLE (diagnostic): compile out the entire core1 subsystem so
// setup1()/loop1() are never defined and no core1 task is spawned.
#if defined(BLEEPIE_MESHTASTIC) && !defined(BLEEPIE_CORE1_DISABLE)

#include <Arduino.h>
#include "hardware/i2c.h"
#include "hardware/gpio.h"
#include "hardware/irq.h"
#include "bleepie_bridge.h"
#include "eeprom_image.h" // generated by embed_badge_app.py (on the variant -I path)

// ---- Pins / identity ----
#define BLP_I2C_SDA 12
#define BLP_I2C_SCL 13
#define BLP_UART_TX 28
#define BLP_UART_RX 29

#define HEX_MAGIC         "THEX"
#define HEX_MANIFEST_VER  "2024"
#define HEX_VID           0x2600
#define HEX_PID           0x7A57
#define HEX_UNIQUE_ID     0x0000
#define HEX_FRIENDLY_NAME "meshtastic"

#define HEX_EEPROM_SIZE   65536
#define HEX_PAGE_SIZE     64
#define HEX_FS_OFFSET     64
#define HEX_I2C_ADDR      0x50

#define I2C_HW i2c0

// (g_bleepieBridge is defined in bleepie_bridge_thread.cpp so it survives even
// when this core1 file is compiled out via BLEEPIE_CORE1_DISABLE.)

// ---- Emulated EEPROM ----
static uint8_t eeprom[HEX_EEPROM_SIZE];
static volatile uint16_t addr = 0;
static volatile uint8_t addrHi = 0;
static volatile enum { S_ADDR_HI, S_ADDR_LO, S_DATA } rxState = S_ADDR_HI;

static uint8_t computeChecksum(const uint8_t *hdr)
{
    uint8_t s = 0x55;
    for (int i = 1; i <= 30; i++)
        s ^= hdr[i];
    return s;
}

static void buildHeader()
{
    uint8_t *h = eeprom;
    memcpy(&h[0], HEX_MAGIC, 4);
    memcpy(&h[4], HEX_MANIFEST_VER, 4);
    h[8] = HEX_FS_OFFSET & 0xFF;
    h[9] = (HEX_FS_OFFSET >> 8) & 0xFF;
    h[10] = HEX_PAGE_SIZE & 0xFF;
    h[11] = (HEX_PAGE_SIZE >> 8) & 0xFF;
    uint32_t total = HEX_EEPROM_SIZE;
    h[12] = total & 0xFF;
    h[13] = (total >> 8) & 0xFF;
    h[14] = (total >> 16) & 0xFF;
    h[15] = (total >> 24) & 0xFF;
    h[16] = HEX_VID & 0xFF;
    h[17] = (HEX_VID >> 8) & 0xFF;
    h[18] = HEX_PID & 0xFF;
    h[19] = (HEX_PID >> 8) & 0xFF;
    h[20] = HEX_UNIQUE_ID & 0xFF;
    h[21] = (HEX_UNIQUE_ID >> 8) & 0xFF;
    memset(&h[22], 0, 9);
    strncpy((char *)&h[22], HEX_FRIENDLY_NAME, 9);
    h[31] = computeChecksum(h);
}

// ---- I2C slave ISR (raw pico-sdk, runs from RAM) ----
static void __not_in_flash_func(i2c_slave_isr)()
{
    i2c_hw_t *hw = I2C_HW->hw;
    uint32_t stat = hw->intr_stat;

    if (stat & I2C_IC_INTR_STAT_R_RX_FULL_BITS) {
        uint8_t b = (uint8_t)hw->data_cmd;
        if (rxState == S_ADDR_HI) {
            addrHi = b;
            rxState = S_ADDR_LO;
        } else if (rxState == S_ADDR_LO) {
            addr = ((uint16_t)addrHi << 8) | b;
            if (addr >= HEX_EEPROM_SIZE)
                addr = 0;
            rxState = S_DATA;
        } else {
            if (addr < HEX_EEPROM_SIZE) {
                eeprom[addr++] = b; // RAM-only: badge writes are not persisted
                if (addr >= HEX_EEPROM_SIZE)
                    addr = 0;
            }
        }
    }

    if (stat & I2C_IC_INTR_STAT_R_RD_REQ_BITS) {
        hw->clr_rd_req;
        hw->data_cmd = eeprom[addr];
        addr = (addr + 1) % HEX_EEPROM_SIZE;
    }

    if (stat & I2C_IC_INTR_STAT_R_STOP_DET_BITS) {
        hw->clr_stop_det;
        rxState = S_ADDR_HI;
    }

    if (stat & I2C_IC_INTR_STAT_R_RESTART_DET_BITS) {
        hw->clr_restart_det;
        rxState = S_ADDR_HI;
    }
}

static void startI2CSlave()
{
    gpio_init(BLP_I2C_SDA);
    gpio_init(BLP_I2C_SCL);
    gpio_set_function(BLP_I2C_SDA, GPIO_FUNC_I2C);
    gpio_set_function(BLP_I2C_SCL, GPIO_FUNC_I2C);
    gpio_pull_up(BLP_I2C_SDA);
    gpio_pull_up(BLP_I2C_SCL);

    i2c_init(I2C_HW, 100000);

    I2C_HW->hw->enable = 0;
    I2C_HW->hw->con = I2C_IC_CON_SPEED_VALUE_FAST << I2C_IC_CON_SPEED_LSB | I2C_IC_CON_IC_RESTART_EN_BITS |
                      I2C_IC_CON_TX_EMPTY_CTRL_BITS;
    I2C_HW->hw->sar = HEX_I2C_ADDR;
    I2C_HW->hw->enable = 1;

    I2C_HW->hw->intr_mask = I2C_IC_INTR_MASK_M_RX_FULL_BITS | I2C_IC_INTR_MASK_M_RD_REQ_BITS |
                            I2C_IC_INTR_MASK_M_STOP_DET_BITS | I2C_IC_INTR_MASK_M_RESTART_DET_BITS;

    irq_set_exclusive_handler(I2C0_IRQ, i2c_slave_isr);
    irq_set_enabled(I2C0_IRQ, true);
}

// ---- UART bridge (Serial1 on GPIO28/29) ----
static String uartBuf;

// Line protocol (badge -> firmware -> badge):
//   status            -> ST <myShort> <nodeCount> <rx> <tx>
//   nodes             -> ND <hex8> <short> <snr> ... NDE
//   chans             -> CH <chIndex> <name> ... CHE
//   msgs              -> MG <seq> <direct> <ch> <fromNumHex> <peerHex> <from> <text>
//                        ... MGE   (newest first; fromNum 0 == our own message)
//   send c<idx> <txt> -> queue a channel broadcast; reply OK/ERR
//   send n<hex8> <txt>-> queue a direct message to a node; reply OK/ERR
static void handleBridgeLine(const String &line)
{
    BleepieBridge &b = g_bleepieBridge;

    if (line.startsWith("status")) {
        Serial1.printf("ST %s %u %lu %lu\n", b.myName, (unsigned)b.nodeCount,
                       (unsigned long)b.rxCount, (unsigned long)b.txCount);

    } else if (line.startsWith("nodes")) {
        uint8_t n = b.numNodes;
        if (n > BLP_MAX_NODES)
            n = BLP_MAX_NODES;
        for (uint8_t i = 0; i < n; i++)
            Serial1.printf("ND %08lx %s %d\n", (unsigned long)b.nodes[i].num,
                           b.nodes[i].shortName, (int)b.nodes[i].snr);
        Serial1.println("NDE");

    } else if (line.startsWith("chans")) {
        uint8_t n = b.numChans;
        if (n > BLP_MAX_CHANS)
            n = BLP_MAX_CHANS;
        for (uint8_t i = 0; i < n; i++)
            Serial1.printf("CH %u %s\n", b.chans[i].index, b.chans[i].name);
        Serial1.println("CHE");

    } else if (line.startsWith("msgs")) {
        uint8_t n = b.numMsgs;
        for (uint8_t k = 0; k < n; k++) { // newest first
            int slot = (int)b.msgHead - 1 - (int)k;
            while (slot < 0)
                slot += BLP_MAX_MSGS;
            BlpMsg &m = b.msgs[slot];
            Serial1.printf("MG %lu %u %u %08lx %08lx %s %s\n", (unsigned long)m.seq,
                           m.direct, m.ch, (unsigned long)m.fromNum,
                           (unsigned long)m.peer, m.from, m.text);
        }
        Serial1.println("MGE");

    } else if (line.startsWith("send ")) {
        if (b.sendPending) {
            Serial1.println("ERR busy");
            return;
        }
        String rest = line.substring(5);
        rest.trim();
        int sp = rest.indexOf(' ');
        if (sp > 1 && (rest[0] == 'c' || rest[0] == 'n')) {
            String dest = rest.substring(0, sp);
            String text = rest.substring(sp + 1);
            if (dest[0] == 'c') {
                b.sendIsNode = 0;
                b.sendDest = (uint32_t)strtoul(dest.c_str() + 1, nullptr, 10);
            } else {
                b.sendIsNode = 1;
                b.sendDest = (uint32_t)strtoul(dest.c_str() + 1, nullptr, 16);
            }
            strncpy(b.sendText, text.c_str(), sizeof(b.sendText) - 1);
            b.sendText[sizeof(b.sendText) - 1] = '\0';
            b.sendPending = true;
            Serial1.println("OK send");
        } else {
            Serial1.println("ERR send");
        }
    }
}

// ---- core1 entry points (weak in the core; strong here) ----
// Bring the hexpansion EEPROM slave up during C++ static init (before main), so
// the Tildagon — which powers the board on insertion and only polls the I2C
// EEPROM for ~1 s — always finds it. Meshtastic's static init pushes the main
// loop (and core1's setup1) out to ~1 s, which is too late; this constructor
// runs first. Mirrors the standalone bleepie firmware's proven early-init.
__attribute__((constructor)) static void bleepieHexpansionEarlyInit()
{
    memset(eeprom, 0xFF, HEX_EEPROM_SIZE);
    buildHeader();

#if EEPROM_IMAGE_SIZE > 0
    uint32_t fsSize = HEX_EEPROM_SIZE - HEX_FS_OFFSET;
    uint32_t copySize = (EEPROM_IMAGE_SIZE < fsSize) ? EEPROM_IMAGE_SIZE : fsSize;
    memcpy(&eeprom[HEX_FS_OFFSET], eeprom_image, copySize);
#endif

    startI2CSlave();
}

// core1: the badge UART bridge. Timing isn't critical here (the badge only polls
// this after its app has loaded), so it stays off core0 on core1.
void setup1()
{
    Serial1.setTX(BLP_UART_TX);
    Serial1.setRX(BLP_UART_RX);
    Serial1.begin(115200);
}

void loop1()
{
    while (Serial1.available()) {
        char c = Serial1.read();
        if (c == '\n' || c == '\r') {
            if (uartBuf.length() > 0) {
                handleBridgeLine(uartBuf);
                uartBuf = "";
            }
        } else {
            uartBuf += c;
            if (uartBuf.length() > 240)
                uartBuf = ""; // guard runaway
        }
    }
    delay(5);
}

#endif // BLEEPIE_MESHTASTIC
